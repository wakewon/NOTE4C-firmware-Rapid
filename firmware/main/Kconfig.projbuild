## firmware/main/Kconfig.projbuild
```kconfig
menu "Xiaozhi Assistant"

config USE_EMOTE_MESSAGE_STYLE
    bool "Use rawdraw 1bpp rendering (no LVGL)"
    default y
    help
        When enabled, the display uses rawdraw 1bpp framebuffer rendering
        instead of LVGL. This is the recommended mode for the ZecTrix
        S3 E-Paper 4.2 board as LVGL causes frequent crashes.

config BOARD_TYPE_ZECTRIX_S3_EPAPER_4_2
    bool "zectrix-s3-epaper-4.2 FT firmware"
    default y
    depends on IDF_TARGET_ESP32S3
    help
        This local repository has been reduced to a single FT-only firmware
        for the zectrix-s3-epaper-4.2 board.

choice ZECTRIX_EPD_PANEL_TYPE
    prompt "ZecTrix EPD panel type"
    default ZECTRIX_EPD_PANEL_4COLOR_SSD2683
    depends on BOARD_TYPE_ZECTRIX_S3_EPAPER_4_2
    help
        Select the e-paper panel connected to the board. The 4-color option
        keeps a semantic 2bpp BWRY UI framebuffer and sends the SSD2683 2bpp
        wire format during refresh. The 1bpp panel build down-converts it.

config ZECTRIX_EPD_PANEL_1BPP
    bool "1bpp black/white EPD"

config ZECTRIX_EPD_PANEL_4COLOR_SSD2683
    bool "4-color BWRY SSD2683 EPD"

endchoice

config ZECTRIX_EPD_4COLOR_BOOT_TEST_PATTERN
    bool "Show 4-color EPD test pattern at boot"
    default n
    depends on ZECTRIX_EPD_PANEL_4COLOR_SSD2683
    help
        Show black/white/red/yellow vertical bars once during display
        initialization so a newly connected 4-color panel can be verified.

config ZECTRIX_EPD_FAST_BW
    bool "Use the official black/yellow RAM-waveform fast refresh"
    default y
    depends on ZECTRIX_EPD_PANEL_4COLOR_SSD2683
    help
        Interactive framebuffer updates are reduced to black/yellow (black and
        red become black, white and yellow become yellow) and driven with the
        panel vendor's 535-byte RAM waveform as differential old->new
        transitions, about 1 s per waveform. The standard full-colour refresh
        still runs automatically after the idle timeouts below. The symbol
        keeps its historical FAST_BW name so existing configurations carry
        over. The controller's persistent MTP is never programmed.

config ZECTRIX_EPD_FAST_BW_IDLE_FULL_SECONDS
    int "Deferred-interaction idle seconds before full-color recovery"
    range 5 3600
    default 30
    depends on ZECTRIX_EPD_FAST_BW
    help
        Used only for menus, cursors and controls where color quality can wait.
        Restart this timer after every deferred-interaction fast request,
        then rebase it when that fast waveform actually completes. This is
        the minimum time the completed preview remains visible.

config ZECTRIX_EPD_FAST_BW_QUALITY_FULL_SECONDS
    int "Quality-mode idle seconds before full-color recovery"
    range 1 3600
    default 10
    depends on ZECTRIX_EPD_FAST_BW
    help
        Default fast-refresh recovery delay for content where color quality
        matters, such as manual photo changes. A new request restarts the
        timer, and the completed result always remains visible for the full
        delay.

config ZECTRIX_EPD_FAST_BY_MIN_PERIOD_MS
    int "Minimum spacing between black/yellow RAM waveforms (ms)"
    range 1000 60000
    default 4000
    depends on ZECTRIX_EPD_FAST_BW
    help
        The vendor demo starts RAM-waveform operations at least four seconds
        apart, including the two halves of an inverse/restore pair. Input
        arriving inside the window is coalesced into the next waveform rather
        than dropped. Lowering this is a panel-stress experiment, not a tuning
        knob.

config ZECTRIX_EPD_FAST_BY_PAGE_CHANGE_PERCENT
    int "Changed-pixel percentage handled as a full-page change"
    range 1 100
    default 30
    depends on ZECTRIX_EPD_FAST_BW
    help
        A black/yellow update touching at least this share of the screen is
        treated like the vendor demo's page change: the old page is inverted
        first, then the new page is drawn from that state. That costs a second
        waveform plus the minimum spacing above, so smaller updates use a
        single differential waveform.

config ZECTRIX_EPD_FAST_BY_CLEANUP_INTERVAL
    int "Single differential updates before an inverse/restore cleanup"
    range 0 100
    default 10
    depends on ZECTRIX_EPD_FAST_BW
    help
        After this many consecutive single differential waveforms, the next
        update is drawn as an inverse/restore pair, which drives every pixel
        once in each direction and clears accumulated ghosting the way the
        vendor demo does after its ten dashboard updates. 0 disables it; the
        idle full-colour recovery still runs either way.

config ZECTRIX_EPD_READ_CLOCK_HZ
    int "SPI clock for EPD register reads (Hz)"
    range 100000 8000000
    default 1000000
    depends on ZECTRIX_EPD_PANEL_4COLOR_SSD2683
    help
        Controller reads are much slower than writes and use the shared SDIN
        line turned around. The first MTP dump was taken at the 8 MHz write
        clock and came back as recognisable data corrupted by bit slips, so
        reads now use this separate, lower clock. Lower it further if the dump
        reports UNSTABLE.

endmenu
```
